## arch/arm64/src/jetson/Kconfig
```kconfig
#
# For a description of the syntax of this configuration file,
# see the file kconfig-language.txt in the NuttX tools repository.
#

if ARCH_CHIP_JETSON

menu "Jetson Board Selection"

choice
	prompt "Jetson Core Configuration"
	default ARCH_CHIP_JETSON_NANO

config ARCH_CHIP_JETSON_NANO
	bool "Jetson Orin Nano Application Processor"
	select ARCH_HAVE_MULTICPU
	select ARMV8A_HAVE_GICv3
	select ARCH_CORTEX_A78AE

endchoice

endmenu

endif # ARCH_CHIP_JETSON
```

## arch/risc-v/src/mpfs/Kconfig
```kconfig
#
# For a description of the syntax of this configuration file,
# see the file kconfig-language.txt in the NuttX tools repository.
#

comment "Polarfire Configuration Options"

config MPFS_ENABLE_DPFPU
	bool "MPFS DP_FPU Support"
	default n
	select ARCH_HAVE_FPU
	select ARCH_HAVE_DPFPU
	---help---
		Enable the RISC-V Double-Precision Floating Point Unit (DP-FPU).

config MPFS_BOOTLOADER
	bool "Initialize HW"
	default n
	---help---
		This NuttX image is used as a bootloader, which will boot only on one hart, putting the others in WFI

config MPFS_BOOT_HART
	int "HART used for booting"
        depends on MPFS_BOOTLOADER
	default 0
	---help---
		The HART number which does the HW initialiization and wakes up the other harts (Default 0, E51 core)

menu "MPFS Peripheral Support"

# These "hidden" settings determine whether a peripheral option is available
# for the selected MCU

config MPFS_HAVE_UART0
	bool
	default n
	select UART0_SERIALDRIVER
	select ARCH_HAVE_SERIAL_TERMIOS

config MPFS_HAVE_UART1
	bool
	default n
	select UART1_SERIALDRIVER
	select ARCH_HAVE_SERIAL_TERMIOS

config MPFS_HAVE_UART2
	bool
	default n
	select UART2_SERIALDRIVER
	select ARCH_HAVE_SERIAL_TERMIOS

config MPFS_HAVE_UART3
	bool
	default n
	select UART3_SERIALDRIVER
	select ARCH_HAVE_SERIAL_TERMIOS

config MPFS_HAVE_UART4
	bool
	default n
	select UART4_SERIALDRIVER
	select ARCH_HAVE_SERIAL_TERMIOS

# These are the peripheral selections proper

config MPFS_UART0
	bool "UART 0"
	default n
	select ARCH_HAVE_UART0
	select ARCH_HAVE_SERIAL_TERMIOS
	select MPFS_HAVE_UART0

config MPFS_UART1
	bool "UART 1"
	default n
	select ARCH_HAVE_UART1
	select ARCH_HAVE_SERIAL_TERMIOS
	select MPFS_HAVE_UART1

config MPFS_UART2
	bool "UART 2"
	default n
	select ARCH_HAVE_UART2
	select ARCH_HAVE_SERIAL_TERMIOS
	select MPFS_HAVE_UART2

config MPFS_UART3
	bool "UART 3"
	default n
	select ARCH_HAVE_UART3
	select ARCH_HAVE_SERIAL_TERMIOS
	select MPFS_HAVE_UART3

config MPFS_UART4
	bool "UART 4"
	default n
	select ARCH_HAVE_UART4
	select ARCH_HAVE_SERIAL_TERMIOS
	select MPFS_HAVE_UART4

endmenu

menu "MPFS Others"


endmenu
```

## fs/shm/Kconfig
```kconfig
#
# For a description of the syntax of this configuration file,
# see the file kconfig-language.txt in the NuttX tools repository.
#

config FS_SHMFS
	bool "Shared memory support"
	select MM_VM_MAP
	default n
	---help---
		Include support for shm_open() and shm_close.

if FS_SHMFS

config FS_SHM_VFS_PATH
	string "Path to shared memory object storage"
	default "/var/shm"
	---help---
		The path to where shared memory objects will exist in the VFS
		namespace.

config FS_SHM_VFS_MAXNAMLEN
	int "Maximum file name length"
	default 128
	---help---
		The maximum size of an SHMFS file name.
		Default: 255.

endif # FS_SHM
```
