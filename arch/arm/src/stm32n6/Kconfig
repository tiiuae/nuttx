## arch/arm/src/stm32n6/Kconfig
```kconfig
#
# For a description of the syntax of this configuration file,
# see the file kconfig-language.txt in the NuttX tools repository.
#

if ARCH_CHIP_STM32N6

comment "STM32N6 Configuration Options"

choice
	prompt "STM32 N6 Chip Selection"
	default ARCH_CHIP_STM32N657X0
	depends on ARCH_CHIP_STM32N6

config ARCH_CHIP_STM32N657X0
    bool "STM32N657X0"
    select ARCH_CORTEXM55
    select STM32N6_STM32N6XXXX

endchoice # STM32 N6 Chip Selection

# Chip families:

config STM32N6_STM32N6XXXX
	bool
	default n
	select ARMV8M_HAVE_DCACHE

comment "STM32N6 Peripherals"

menu "STM32N6 Peripheral Selection"

# These "hidden" settings are the OR of individual peripheral selections
# indicating that the general capability is required.

config STM32N6_TIM
	bool
	default n

config STM32N6_SPI
	bool
	default n

config STM32N6_I2C
	bool
	default n

config STM32N6_USART
	bool
	default n

config STM32N6_DMA
	bool
	default n

# These are the peripheral selections proper

menu "STM32H7 Timer Selection"

config STM32N6_TIM1
	bool "TIM1"
	default n
	select STM32N6_TIM

config STM32N6_TIM2
	bool "TIM2"
	default n
	select STM32N6_TIM

config STM32N6_TIM3
	bool "TIM3"
	default n
	select STM32N6_TIM

config STM32N6_TIM4
	bool "TIM4"
	default n
	select STM32N6_TIM

config STM32N6_TIM5
	bool "TIM5"
	default n
	select STM32N6_TIM

config STM32N6_TIM6
	bool "TIM6"
	default n
	select STM32N6_TIM

config STM32N6_TIM7
	bool "TIM7"
	default n
	select STM32N6_TIM

config STM32N6_TIM8
	bool "TIM8"
	default n
	select STM32N6_TIM

config STM32N6_TIM9
	bool "TIM9"
	default n
	select STM32N6_TIM

config STM32N6_TIM10
	bool "TIM10"
	default n
	select STM32N6_TIM

config STM32N6_TIM11
	bool "TIM11"
	default n
	select STM32N6_TIM

config STM32N6_TIM12
	bool "TIM12"
	default n
	select STM32N6_TIM

config STM32N6_TIM13
	bool "TIM13"
	default n
	select STM32N6_TIM

config STM32N6_TIM14
	bool "TIM14"
	default n
	select STM32N6_TIM

config STM32N6_TIM15
	bool "TIM15"
	default n
	select STM32N6_TIM

config STM32N6_TIM16
	bool "TIM16"
	default n
	select STM32N6_TIM

config STM32N6_TIM17
	bool "TIM17"
	default n
	select STM32N6_TIM

config STM32N6_TIM18
	bool "TIM18"
	default n
	select STM32N6_TIM

endmenu # STM32N6 Timer Selection

menu "STM32H7 SPI Selection"

config STM32N6_SPI1
	bool "SPI1"
	default n
	select SPI
	select STM32N6_SPI

config STM32N6_SPI2
	bool "SPI2"
	default n
	select SPI
	select STM32N6_SPI

config STM32N6_SPI3
	bool "SPI3"
	default n
	select SPI
	select STM32N6_SPI

config STM32N6_SPI4
	bool "SPI4"
	default n
	select SPI
	select STM32N6_SPI

config STM32N6_SPI5
	bool "SPI5"
	default n
	select SPI
	select STM32N6_SPI

config STM32N6_SPI6
	bool "SPI6"
	default n
	select SPI
	select STM32N6_SPI

endmenu # STM32N6 SPI Selection

menu "STM32H7 I2C Selection"

config STM32N6_I2C1
	bool "I2C1"
	default n
	select STM32N6_I2C

config STM32N6_I2C2
	bool "I2C2"
	default n
	select STM32N6_I2C

config STM32N6_I2C3
	bool "I2C3"
	default n
	select STM32N6_I2C

config STM32N6_I2C4
	bool "I2C4"
	default n
	select STM32N6_I2C

endmenu # STM32N6 I2C Selection

menu "STM32N6 U[S]ART Selection"

config STM32N6_USART1
	bool "USART1"
	default n
	select USART1_SERIALDRIVER
	select ARCH_HAVE_SERIAL_TERMIOS
	select STM32N6_USART

config STM32N6_USART2
	bool "USART2"
	default n
	select USART2_SERIALDRIVER
	select ARCH_HAVE_SERIAL_TERMIOS
	select STM32N6_USART

config STM32N6_USART3
	bool "USART3"
	default n
	select USART3_SERIALDRIVER
	select ARCH_HAVE_SERIAL_TERMIOS
	select STM32N6_USART

config STM32N6_UART4
	bool "UART4"
	default n
	select UART4_SERIALDRIVER
	select ARCH_HAVE_SERIAL_TERMIOS
	select STM32N6_USART

config STM32N6_UART5
	bool "UART5"
	default n
	select UART5_SERIALDRIVER
	select ARCH_HAVE_SERIAL_TERMIOS
	select STM32N6_USART

config STM32N6_USART6
	bool "USART6"
	default n
	select USART6_SERIALDRIVER
	select ARCH_HAVE_SERIAL_TERMIOS
	select STM32N6_USART

config STM32N6_UART7
	bool "UART7"
	default n
	select UART7_SERIALDRIVER
	select ARCH_HAVE_SERIAL_TERMIOS
	select STM32N6_USART

config STM32N6_UART8
	bool "UART8"
	default n
	select UART8_SERIALDRIVER
	select ARCH_HAVE_SERIAL_TERMIOS
	select STM32N6_USART

config STM32N6_UART9
	bool "UART9"
	default n
	select UART9_SERIALDRIVER
	select ARCH_HAVE_SERIAL_TERMIOS
	select STM32N6_USART

config STM32N6_USART10
	bool "USART10"
	default n
	select USART10_SERIALDRIVER
	select ARCH_HAVE_SERIAL_TERMIOS
	select STM32N6_USART

endmenu # U[S]ART Selection

config STM32N6_XSPI
	bool "STM32N6 XSPI2 controller"
	default n
	select SPI
	---help---
		Enable the experimental N6 XSPI2 QSPI interface scaffold for the
		NUCLEO-N657X0-Q external flash. Transfers are not implemented yet.


menu "STM32N6 DMA Configuration"

config STM32N6_GPDMA1
	bool "Enable GPDMA1"
	select STM32N6_DMA
	select ARCH_DMA
	default n
	---help---
		Enable the 16-channel GPDMA1 controller.

config STM32N6_GPDMA1_NCHANNELS
	int "GPDMA1 channel pool size"
	depends on STM32N6_GPDMA1
	range 1 16
	default 16
	---help---
		Number of low-numbered GPDMA1 channels made available to the DMA
		driver.

config STM32N6_GPDMA1_RESERVED_CHANNELS
	int "GPDMA1 channels reserved from allocation"
	depends on STM32N6_GPDMA1
	range 0 16
	default 0
	---help---
		Number of low-numbered GPDMA1 channels withheld from general
		allocation for board or peripheral reservations.

config STM32N6_HPDMA1
	bool "Enable HPDMA1"
	select STM32N6_DMA
	select ARCH_DMA
	default n
	---help---
		Enable the 16-channel HPDMA1 controller.

config STM32N6_HPDMA1_NCHANNELS
	int "HPDMA1 channel pool size"
	depends on STM32N6_HPDMA1
	range 1 16
	default 16
	---help---
		Number of low-numbered HPDMA1 channels made available to the DMA
		driver.

config STM32N6_HPDMA1_RESERVED_CHANNELS
	int "HPDMA1 channels reserved from allocation"
	depends on STM32N6_HPDMA1
	range 0 16
	default 0
	---help---
		Number of low-numbered HPDMA1 channels withheld from general
		allocation for board or peripheral reservations.

config STM32N6_DMA_DIAGNOSTICS
	bool "DMA diagnostics"
	depends on STM32N6_DMA
	default n
	---help---
		Enable additional diagnostics in the STM32N6 DMA driver.

config STM32N6_DMA_LINKEDLIST
	bool "DMA linked-list support"
	depends on STM32N6_DMA
	default n
	---help---
		Enable linked-list DMA operations.

config STM32N6_DMA_CIRCULAR
	bool "DMA circular operation support"
	depends on STM32N6_DMA_LINKEDLIST
	default n
	---help---
		Enable circular and ping-pong linked-list DMA operations.

endmenu

menu "STM32N6 SPI DMA Configuration"

choice
	prompt "SPI DMA controller"
	depends on STM32N6_SPI
	default STM32N6_SPI_DMA_GPDMA1

config STM32N6_SPI_DMA_GPDMA1
	bool "GPDMA1"
	select STM32N6_GPDMA1

config STM32N6_SPI_DMA_HPDMA1
	bool "HPDMA1"
	select STM32N6_HPDMA1

endchoice

endmenu

menu "STM32N6 USB OTG Configuration"

config STM32N6_OTGDEV
	bool "USB OTG device enable"
	default n
	select USBDEV
	---help---
		Initialize the selected STM32N6 USB controller and integrated
		PHY with bounded waits. The board must supply a qualified HSE
		clock/settling contract. The current Nucleo settling allowance
		is experimental and requires physical qualification.

		Supports control, bulk, and interrupt transfers through the
		integrated FIFO RAM. Connection requires a bound class and an
		explicit, board-qualified VBUS notification. No board GPIO,
		Type-C protection, or VBUS source gates are configured here.

		Only one integrated HS controller can be selected. Host, DMA,
		isochronous, composite, and superspeed configurations are rejected
		at build time. Keep this disabled on operational boards.

if STM32N6_OTGDEV

choice
	prompt "USB device controller"
	default STM32N6_OTG1

config STM32N6_OTG1
	bool "USB1 OTG HS"

config STM32N6_OTG2
	bool "USB2 OTG HS"

endchoice

config STM32N6_OTGDEV_FS
	bool "Force full-speed device operation"
	default y
	---help---
		Use full-speed device mode with the integrated HS PHY for initial
		bring-up. Do not enable USBDEV_DUALSPEED with this option.

config USBDEV_SETUP_MAXDATASIZE
	int "Maximum control OUT payload"
	default 4096
	range 128 65535
	---help---
		Storage for multi-packet control OUT requests, independent of
		EP0's 64-byte packet size. Larger requests are stalled explicitly.
		This buffer is statically allocated; do not increase it unless
		the bound class requires a larger control payload.

endif # STM32N6_OTGDEV

endmenu # STM32N6 USB OTG Configuration

endmenu # STM32N6 Peripheral Selection

endif # ARCH_CHIP_STM32N6
```

## boards/arm/stm32n6/nucleo-n657x0-q/Kconfig
```kconfig
#
# For a description of the syntax of this configuration file,
# see the file kconfig-language.txt in the NuttX tools repository.
#

if ARCH_BOARD_NUCLEO_N657X0_Q

choice
	prompt "Boot configuration"
	default NUCLEO_N657X0_Q_BOOT_SRAM
	---help---
		The STM32N657X0 has no internal flash, so where the image lives has
		to be decided at build time.  This selects the linker script and the
		startup path used for the build.


config NUCLEO_N657X0_Q_BOOT_SRAM
	bool "DEV boot mode (image downloaded into SRAM)"
	---help---
		Link everything to run from AXISRAM at 0x34000400 and load it there
		directly, which is what the ST-Link does in DEV boot mode.  This is
		the quickest edit/debug cycle: the image can be downloaded with a
		plain "load" from GDB and no external flash is involved.

		Nothing is retained across a power cycle: the board has to be
		re-loaded by the debugger on every boot.  tools/sramload.sh does
		that with STM32_Programmer_CLI.

		Uses scripts/sram.ld.

config NUCLEO_N657X0_Q_BOOT_XSPI
	bool "Boot from external XSPI2 NOR flash"
	---help---
		Build the second-stage application for the external Octo-SPI NOR
		(MX25UM51245G) on XSPI2.  The signed image is programmed at
		0x70100000, reserving 1 MiB at 0x70000000 for the SRAM2 bootloader.

		The application is fully XIP: code and read-only data execute from
		the XSPI2 memory window, while only writable data is copied to AXI
		SRAM at startup.  The bootloader must configure XSPI2 for 200 MHz
		memory-mapped reads before entering this image.

		The build produces nuttx-signed.bin, i.e. nuttx.bin wrapped in an
		STM32 v2.3 boot header by tools/mkimage.sh.  That requires
		STM32_SigningTool_CLI, which is looked up via the STM32_PRG_PATH
		environment variable.  Build and program the `bl` configuration at
		0x70000000, then program this result at 0x70100000.

		Uses scripts/flash.ld.

endchoice # Boot configuration

config NUCLEO_N657X0_Q_BOOTLOADER
	bool "Build SRAM2 bootloader image"
	depends on !NUCLEO_N657X0_Q_BOOT_XSPI
	---help---
		Build a small NuttX bootloader that the STM32N6 boot ROM loads from
		external XSPI2 flash into AXI SRAM2 at 0x34180000.  The linked image
		starts at 0x34180400, after the boot ROM's 1 KiB context area, and
		runs bootloader_main().

		This is separate from the boot-mode choice: it uses scripts/bl_flash.ld
		and is packaged with a ROM load address of 0x34180000.  It must not be
		combined with CONFIG_NUCLEO_N657X0_Q_BOOT_XSPI, which is the XIP-stub
		configuration.

config NUCLEO_N657X0_Q_TIMER_CLOCKTEST
	bool "Test timer functionality"
	---help---
		Run a short TIM1 and TIM5 clock test during board bringup.

config NUCLEO_N657X0_Q_DMA_POLICYTEST
	bool "Test DMA core and access policy"
	depends on STM32_DMA
	---help---
		Check controller security masks, direct memory copies, callback and
		status reporting, request/direction validation, USART transfer setup,
		and bounded abort behavior.

config NUCLEO_N657X0_Q_GPIO_EXTI_TEST
	bool "Test GPIO EXTI with the blue user button"
	depends on USERLED_LOWER && !ARCH_LEDS
	---help---
		Configure the blue user button on PC13 as an active-high EXTI
		input with a pull-down. Wait up to three seconds for a button
		press during board bringup. The blue user LED turns on while
		the button is pressed and off when it is released.

config NUCLEO_N657X0_Q_SPI5_BMP280_TEST
	bool "Read BMP280 data over SPI5 during bringup"
	depends on STM32_SPI5
	---help---
		Read the BMP280 chip ID and raw pressure and temperature ADC values
		over SPI5 using Arduino D10 (PA3) as chip select.

config NUCLEO_N657X0_Q_SPI5_LOOPBACK_TEST
	bool "Test SPI5 MOSI-to-MISO loopback during bringup"
	depends on STM32_SPI5 && SPI_EXCHANGE && !NUCLEO_N657X0_Q_SPI5_BMP280_TEST
	---help---
		Send a test pattern over SPI5 and verify the received bytes match.
		Disconnect the BMP280 SDO from MISO, then jumper Arduino D11 (MOSI,
		PG2) to D12 (MISO, PG1). The BMP280 chip select on D10 (PA3) stays
		inactive during the test.

config NUCLEO_N657X0_Q_I2C2
	bool "Initialize I2C2 for board clients and the NSH I2C tool"
	depends on I2C && STM32_I2C2
	default n
	---help---
		Initialize the board-routed I2C2 bus on PB10/PB11 during bring-up.
		Register /dev/i2c2 when CONFIG_I2C_DRIVER is enabled. The Nucleo
		board timing inputs remain intentionally unqualified; I2C2 setup
		fails closed until the timing settings below contain qualified values.

if NUCLEO_N657X0_Q_I2C2

config NUCLEO_N657X0_Q_I2C2_RISE_TIME_NS
	int "Qualified I2C2 rise time (ns)"
	default 0
	range 0 1000

config NUCLEO_N657X0_Q_I2C2_FALL_TIME_NS
	int "Qualified I2C2 fall time (ns)"
	default 0
	range 0 300

config NUCLEO_N657X0_Q_I2C2_CLOCK_TOLERANCE_PPM
	int "Worst-case I2C2 kernel clock tolerance (ppm)"
	default 0
	range 0 999999
	---help---
		Include the HSI oscillator tolerance for the intended voltage and
		temperature range. Zero is an unqualified board placeholder.

endif

menuconfig NUCLEO_N657X0_Q_USBDEV
	bool "Experimental CN8 static-sink CDC-ACM bring-up"
	depends on EXPERIMENTAL && STM32_N6_OTGDEV && STM32_N6_OTG1
	depends on CDCACM && !CDCACM_CONSOLE && !CDCACM_COMPOSITE
	depends on NUCLEO_N657X0_Q_BOOT_SRAM && !NUCLEO_N657X0_Q_BOOTLOADER
	depends on !ARCH_TRUSTZONE_NONSECURE
	depends on USART1_SERIAL_CONSOLE
	select STM32_I2C2
	select NUCLEO_N657X0_Q_I2C2
	select SCHED_LPWORK
	default n
	---help---
		Bind CDC-ACM once at bring-up, preserving the ST-LINK UART console.
		Use UCPD Rd on both CC lines and TCPP03 low-power VBUS observation
		for factory-standard MB1940-N657X0Q-C02, powered by CN10 with
		CN9 [1-2]. Never enable the provider path, VCONN, or USB PD.
		Do not also enable the sercon application or another class owner.

if NUCLEO_N657X0_Q_USBDEV

config NUCLEO_N657X0_Q_USBDEV_QUALIFIED
	bool "Board attachment/power policy has been physically qualified"
	default n
	depends on NUCLEO_N657X0_Q_I2C2_RISE_TIME_NS > 0
	depends on NUCLEO_N657X0_Q_I2C2_FALL_TIME_NS > 0
	depends on NUCLEO_N657X0_Q_I2C2_CLOCK_TOLERANCE_PPM > 0
	---help---
		Only enable after qualifying I2C2 timings, HSE frequency/settling,
		USB rails, Rd in both orientations, TCPP03 status/FLGn attach and
		detach, absence of VBUS back-feed, and descriptor bus-current
		budget. TCPP03 VBUS_OK is a presence detector at approximately
		2.4 V, not a precision 5 V measurement.

		Without this acknowledgement CDC-ACM is registered locally, but
		CN8 remains disconnected and bring-up reports EAGAIN.
		Refer to the board README for the qualification procedure.

endif

endif
```
