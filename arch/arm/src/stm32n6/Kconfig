## boards/arm/stm32n6/nucleo-n657x0-q/configs/nsh-test/defconfig
```kconfig
CONFIG_ARCH="arm"
CONFIG_ARCH_BOARD="nucleo-n657x0-q"
CONFIG_ARCH_BOARD_NUCLEO_N657X0_Q=y
CONFIG_ARCH_CHIP="stm32n6"
CONFIG_ARCH_CHIP_STM32=y
CONFIG_ARCH_CHIP_STM32N657X0=y
CONFIG_ARCH_CHIP_STM32N6=y
CONFIG_ARMV8M_DCACHE=y
CONFIG_ARCH_INTERRUPTSTACK=4096
CONFIG_ARCH_LEDS=y
CONFIG_ARCH_STACKDUMP=y
CONFIG_BOARD_LOOPSPERMSEC=21000
CONFIG_BUILTIN=y
CONFIG_DEBUG_FEATURES=y
CONFIG_DEBUG_HARDFAULT_ALERT=y
CONFIG_FS_PROCFS=y
CONFIG_HAVE_CXX=y
CONFIG_HAVE_CXXINITIALIZE=y
CONFIG_IDLETHREAD_STACKSIZE=4096
CONFIG_INIT_ENTRYPOINT="nsh_main"
CONFIG_NSH_BUILTIN_APPS=y
CONFIG_NSH_FILEIOSIZE=512
CONFIG_NSH_PROC_MOUNTPOINT="/proc"
CONFIG_NSH_READLINE=y
CONFIG_NUCLEO_N657X0_Q_DMA_POLICYTEST=y
CONFIG_NUCLEO_N657X0_Q_GPIO_EXTI_TEST=y
CONFIG_NUCLEO_N657X0_Q_TIMER_CLOCKTEST=y
CONFIG_NUCLEO_N657X0_Q_SPI5_BMP280_TEST=y
# CONFIG_NUCLEO_N657X0_Q_SPI5_LOOPBACK_TEST is not set
CONFIG_RAM_SIZE=4193280
CONFIG_RAM_START=0x34000400
CONFIG_RAW_BINARY=y
CONFIG_RR_INTERVAL=200
CONFIG_SCHED_CPULOAD_SYSCLK=y
CONFIG_SCHED_WAITPID=y
CONFIG_STM32_DMA_CIRCULAR=y
CONFIG_STM32_DMA_LINKEDLIST=y
CONFIG_STM32_GPDMA1=y
CONFIG_STM32_HPDMA1=y
CONFIG_STM32_I2C2=y
CONFIG_STM32_SPI5=y
CONFIG_STM32_STM32N6XXXX=y
CONFIG_STM32_USART1=y
CONFIG_STM32_USART3=y
CONFIG_SYSTEM_NSH=y
CONFIG_USART1_SERIAL_CONSOLE=y
CONFIG_USART1_TXDMA=y

# CONFIG_EXPERIMENTAL is not set
# CONFIG_STM32_N6_OTGDEV is not set
# CONFIG_STM32_N6_OTG1 is not set
# CONFIG_STM32_N6_OTGDEV_FS is not set
# CONFIG_CDCACM is not set
# CONFIG_NUCLEO_N657X0_Q_USBDEV is not set

CONFIG_DEBUG_FEATURES=y
CONFIG_DEBUG_USB=y
CONFIG_DEBUG_USB_ERROR=y
CONFIG_DEBUG_USB_WARN=y
CONFIG_USBDEV_TRACE=y
CONFIG_USBDEV_TRACE_STRINGS=y
CONFIG_USBMONITOR=y
CONFIG_USBMONITOR_TRACEINIT=y
CONFIG_USBMONITOR_TRACECLASS=y
CONFIG_USBMONITOR_TRACECONTROLLER=y

CONFIG_NUCLEO_N657X0_Q_I2C2_RISE_TIME_NS=300
CONFIG_NUCLEO_N657X0_Q_I2C2_FALL_TIME_NS=20
CONFIG_NUCLEO_N657X0_Q_I2C2_CLOCK_TOLERANCE_PPM=15000

CONFIG_I2C=y
CONFIG_I2C_DRIVER=y
CONFIG_SYSTEM_I2CTOOL=y
CONFIG_NUCLEO_N657X0_Q_I2C2=y

CONFIG_I2CTOOL_DEFFREQ=100000
CONFIG_I2CTOOL_MINBUS=2
CONFIG_I2CTOOL_MAXBUS=2
```
